## sdkconfig.defaults
```kconfig
# LVGL configuration
CONFIG_LV_MEM_CUSTOM=y
CONFIG_LV_MEMCPY_MEMSET_STD=y
CONFIG_LV_USE_USER_DATA=y
CONFIG_LV_USE_PERF_MONITOR=y
CONFIG_LV_FONT_MONTSERRAT_32=y
CONFIG_LV_FONT_MONTSERRAT_48=y

# Flash size
CONFIG_ESPTOOLPY_FLASHSIZE_16MB=y
CONFIG_PARTITION_TABLE_CUSTOM=y

# ESP32-S3 specific
CONFIG_ESP32S3_DATA_CACHE_LINE_64B=y
CONFIG_ESP32S3_DATA_CACHE_LINE_SIZE=64
CONFIG_ESP32S3_DEFAULT_CPU_FREQ_240=y
CONFIG_ESP32S3_DEFAULT_CPU_FREQ_MHZ=240

# PSRAM (OPI SPIRAM)
CONFIG_SPIRAM=y
CONFIG_SPIRAM_MODE_OCT=y
CONFIG_SPIRAM_SPEED_80M=y
CONFIG_SPIRAM_FETCH_INSTRUCTIONS=y
CONFIG_SPIRAM_RODATA=y

# RGB panel display settings (bounce buffer, no double FB, tear avoidance)
# CONFIG_EXAMPLE_DOUBLE_FB is not set
CONFIG_EXAMPLE_USE_BOUNCE_BUFFER=y
CONFIG_EXAMPLE_AVOID_TEAR_EFFECT_WITH_SEM=y
```

## src/Kconfig.projbuild
```kconfig
menu "Display Configuration"
    config EXAMPLE_DOUBLE_FB
        bool "Use double Frame Buffer"
        default n
        help
            Enable this option, driver will allocate two frame buffers.

    config EXAMPLE_USE_BOUNCE_BUFFER
        depends on !EXAMPLE_DOUBLE_FB
        bool "Use bounce buffer"
        default y
        help
            Enable bounce buffer mode for higher PCLK frequency at cost of CPU.

    config EXAMPLE_AVOID_TEAR_EFFECT_WITH_SEM
        depends on !EXAMPLE_DOUBLE_FB
        bool "Avoid tearing effect"
        default y
        help
            Use a pair of semaphores to avoid screen tearing.
endmenu
```
